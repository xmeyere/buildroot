## configs/xm8536d_defconfig
```kconfig
# Architecture
BR2_arm=y
BR2_cortex_a9=y
BR2_ARM_ENABLE_NEON=y
BR2_ARM_ENABLE_VFP=y

# Toolchain
BR2_TOOLCHAIN_BUILDROOT_UCLIBC=y
BR2_TOOLCHAIN_BUILDROOT_LIBC="uclibc"
BR2_PACKAGE_UCLIBC=y
BR2_PACKAGE_HOST_LINUX_HEADERS_CUSTOM_5_0=y

# Linux
BR2_LINUX_KERNEL=y
BR2_LINUX_KERNEL_CUSTOM_GIT=y
BR2_LINUX_KERNEL_CUSTOM_REPO_URL="https://github.com/xmeyere/linux.git"
BR2_LINUX_KERNEL_CUSTOM_REPO_VERSION="ebef755"
BR2_LINUX_KERNEL_VERSION="5.0.1"
BR2_LINUX_KERNEL_UIMAGE=y
BR2_LINUX_KERNEL_USE_CUSTOM_CONFIG=y
BR2_LINUX_KERNEL_CUSTOM_CONFIG_FILE="board/xmeye/xm8536d/linux.config"
BR2_LINUX_KERNEL_XZ=y
BR2_LINUX_KERNEL_UIMAGE_LOADADDR="80008000"

BR2_PACKAGE_XMEYE_KERNEL_MODULE=y

# Busybox
BR2_PACKAGE_BUSYBOX=y

# Target
BR2_TARGET_ROOTFS_SQUASHFS=y
BR2_TARGET_ROOTFS_SQUASHFS4_XZ=y
BR2_ROOTFS_POST_BUILD_SCRIPT="board/xmeye/post-build.sh"
BR2_ROOTFS_POST_IMAGE_SCRIPT="board/xmeye/post-image.sh"
```

## package/xmeye_kernel_module/Config.in
```kconfig
config BR2_PACKAGE_XMEYE_KERNEL_MODULE
        bool "xmeye_kernel_module"
        depends on BR2_LINUX_KERNEL
        help
                Linux Kernel modules for XMEYE boards
```
